## apps/arcs-mini/Kconfig
```kconfig
osource "$ARCS_BASE/Kconfig"

menu "Voice Application"

rsource "../../modules/Kconfig"
rsource "../../src/Kconfig"
orsource "../../apps-ui/Kconfig"

rsource "miniapp/Kconfig"

config SHENGSHENG_AVATAR
    bool "Shengsheng pixel companion on the voice home screen"
    depends on APPLICATION_UI && BOARD_ARCS_MINI3
    default n
    help
      Replace the voice assistant's home animations with the Shengsheng
      pixel pet. Keep the normal voice session, subtitles and system controls.
      This option does not change the acoustic wake-word model or cloud persona.

config STOCK_WATCH
    bool "Stock quotes on Shengsheng's idle home screen"
    depends on SHENGSHENG_AVATAR
    default n
    help
      Show Espressif (688018) and NVIDIA (NVDA) quotes using a public feed.
      Refresh every 15 seconds during regular-hours schedules, otherwise
      every 60 seconds. US quotes may be delayed. No alerts or trading.

config CP_FIRMWARE_COMPAT
    bool "Embed CP PSRAM range"
    default y
    help
      Store the CP PSRAM base and size selected by prj.conf immediately after the
      standard ARCS image header so AP can reject an incompatible CP image.

config CP_FIRMWARE_COMPAT_OFFSET
    hex "CP PSRAM range image offset"
    default 0x180
    depends on CP_FIRMWARE_COMPAT
    help
      Offset from the CP image base. Keep this synchronized with AP.

endmenu
```
